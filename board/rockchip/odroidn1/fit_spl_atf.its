## board/rockchip/odroidn1/fit_spl_atf.its
```
/*
 * Copyright (C) 2018 Hardkernel Co,. Ltd
 * 	Joy Cho <joy.cho@hardkernel.com>

 * Minimal dts for a SPL FIT image payload.
 *
 * SPDX-License-Identifier: GPL-2.0+  X11
 */

/dts-v1/;

/ {
	description = "FIT image with U-Boot proper, ATF bl31, M0 Firmware, DTB";
	#address-cells = <1>;

	images {
		uboot {
			description = "U-Boot (64-bit)";
			data = /incbin/("../../../u-boot-dtb.bin");
			type = "standalone";
			os = "U-Boot";
			arch = "arm64";
			compression = "none";
			load = <0x00200000>;
		};
		atf {
			description = "ARM Trusted Firmware";
			data = /incbin/("./firmware/bl31-rk3399.bin");
			type = "firmware";
			arch = "arm64";
			os = "arm-trusted-firmware";
			compression = "none";
			load = <0x1000>;
			entry = <0x1000>;
		};
		pmu {
		        description = "Cortex-M0 firmware";
			data = /incbin/("./firmware/rk3399m0.bin");
			type = "pmu-firmware";
			compression = "none";
			load = <0x180000>;
                };
		fdt {
			description = "RK3399 ODROID-N1 flat device-tree";
			data = /incbin/("../../../u-boot.dtb");
			type = "flat_dt";
			compression = "none";
		};
	};

	configurations {
		default = "conf";
		conf {
			description = "Hardkernel ODROID-N1";
			firmware = "atf";
			loadables = "uboot", "pmu";
			fdt = "fdt";
		};
	};
};
```
